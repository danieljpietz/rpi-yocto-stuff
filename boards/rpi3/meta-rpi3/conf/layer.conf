## layers/meta-user/conf/layer.conf
```bitbake
BBPATH .= ":${LAYERDIR}"

BBFILES += "${LAYERDIR}/recipes-*/*/*.bb \
            ${LAYERDIR}/recipes-*/*/*.bbappend"

BBFILE_COLLECTIONS += "user"
BBFILE_PATTERN_user = "^${LAYERDIR}/"
BBFILE_PRIORITY_user = "11"
LAYERSERIES_COMPAT_user = "scarthgap"
```
